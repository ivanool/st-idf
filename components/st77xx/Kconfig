## components/st77xx/Kconfig
```kconfig
menu "ST77XX Display Driver"

    choice ST77XX_MODEL
        prompt "Display controller model"
        default ST77XX_MODEL_ST7796S
        help
            Select the display controller model.

        config ST77XX_MODEL_ST7789
            bool "ST7789 (240x135 / 240x240)"
            help
                ST7789 controller for small displays.

        config ST77XX_MODEL_ST7796S
            bool "ST7796S (480x320)"
            select SPIRAM if IDF_TARGET_ESP32S3
            help
                ST7796S controller for 3.5" displays.
                Automatically enables PSRAM on ESP32-S3.
    endchoice

    config ST77XX_USE_PSRAM
        bool "Use PSRAM for framebuffer"
        default y if ST77XX_MODEL_ST7796S && SPIRAM
        default n
        depends on SPIRAM
        help
            Use PSRAM for display framebuffer. Recommended for ST7796S.

endmenu
```

## main/Kconfig
```kconfig
menu "Memory Monitor"

config MEM_MONITOR_ENABLE
    bool "Enable runtime memory monitor"
    default y
    help
      If enabled the application will periodically log heap, SRAM and
      PSRAM usage at the interval configured below.

config MEM_MONITOR_INTERVAL_MS
    int "Memory monitor interval (ms)"
    default 5000
    range 1000 60000
    help
      Interval in milliseconds between memory usage logs.

endmenu
```

## sdkconfig.defaults
```kconfig
# Tabla de particiones personalizada
CONFIG_PARTITION_TABLE_CUSTOM=y
CONFIG_PARTITION_TABLE_CUSTOM_FILENAME="partitions.csv"
CONFIG_PARTITION_TABLE_FILENAME="partitions.csv"

# Tamaño de flash (8MB)
CONFIG_ESPTOOLPY_FLASHSIZE_8MB=y
CONFIG_ESPTOOLPY_FLASHSIZE="8MB"

# ST77XX Display - ST7796S con PSRAM automática
CONFIG_ST77XX_MODEL_ST7796S=y
CONFIG_ST77XX_USE_PSRAM=y

# PSRAM habilitada (ESP32-S3 con Octal PSRAM)
CONFIG_SPIRAM=y
CONFIG_SPIRAM_MODE_OCT=y
CONFIG_SPIRAM_SPEED_80M=y

# Optimización
CONFIG_COMPILER_OPTIMIZATION_PERF=y
```
